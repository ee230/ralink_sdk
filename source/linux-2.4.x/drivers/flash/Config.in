## source/linux-2.4.x/net/nat/hw_nat/Config.in
```kconfig
#
# RT2880 HWNAT configuration
#

dep_tristate 'Ralink HW NAT' CONFIG_RA_HW_NAT

if [ "$CONFIG_RA_HW_NAT" != "n" ]; then

comment 'Binding'
choice 'Binding Method '  "Auto    CONFIG_RA_HW_NAT_AUTO_BIND \
			   Semi-Auto CONFIG_RA_HW_NAT_SEMIAUTO_BIND \
                           Manual  CONFIG_RA_HW_NAT_MANUAL_BIND
                          "Auto
int 'Binding Threshold (Unit:Packet Per Second)' CONFIG_RA_HW_NAT_BINDING_THRESHOLD 20
int 'Max entries allowed build when FreeEntries>3/4 (MUST <16384)' CONFIG_RA_HW_NAT_QURT_LMT 100
int 'Max entries allowed build when FreeEntries>1/2 (MUST <16384)' CONFIG_RA_HW_NAT_HALF_LMT 50
int 'Max entries allowed build when FreeEntries<1/2 (MUST <16384)' CONFIG_RA_HW_NAT_FULL_LMT 25

comment 'Foe Table'
choice ' Foe Table Size'  "1K      CONFIG_RA_HW_NAT_TBL_1K \
                           2K      CONFIG_RA_HW_NAT_TBL_2K \
                           4K      CONFIG_RA_HW_NAT_TBL_4K \
                           8K      CONFIG_RA_HW_NAT_TBL_8K \
                           16K     CONFIG_RA_HW_NAT_TBL_16K \
                          "4K

choice ' Hash Algorithm'  "Hash0-Simple   CONFIG_RA_HW_NAT_HASH0 \
                           Hash1-Complex  CONFIG_RA_HW_NAT_HASH1 \
                          "Hash0

comment 'Policy Table (Total Size MUST <= 512)'
int 'Pre ACL Table Size'                CONFIG_RA_HW_NAT_PRE_ACL_SIZE   112
int 'Pre Meter Table Size'              CONFIG_RA_HW_NAT_PRE_MTR_SIZE   100
int 'Pre Accounting Table Size'         CONFIG_RA_HW_NAT_PRE_AC_SIZE    100
int 'Post Meter Table Size'             CONFIG_RA_HW_NAT_POST_MTR_SIZE  100
int 'Post Accounting Table Size'        CONFIG_RA_HW_NAT_POST_AC_SIZE   100


comment 'KeepAlive Interval'
if [ "$CONFIG_RA_HW_NAT_TBL_1K" != "n" ];then
int '  TCP KeepAlive Interval(Unit:1Sec)' CONFIG_RA_HW_NAT_TCP_KA  5
int '  UDP KeepAlive Interval(Unit:1Sec)' CONFIG_RA_HW_NAT_UDP_KA  5
elif [ "$CONFIG_RA_HW_NAT_TBL_2K" != "n" ];then
int '  TCP KeepAlive Interval(Unit:2Sec)' CONFIG_RA_HW_NAT_TCP_KA  3
int '  UDP KeepAlive Interval(Unit:2Sec)' CONFIG_RA_HW_NAT_UDP_KA  3
elif [ "$CONFIG_RA_HW_NAT_TBL_4K" != "n" ];then
int '  TCP KeepAlive Interval(Unit:4Sec)' CONFIG_RA_HW_NAT_TCP_KA  1
int '  UDP KeepAlive Interval(Unit:4Sec)' CONFIG_RA_HW_NAT_UDP_KA  1
elif [ "$CONFIG_RA_HW_NAT_TBL_8K" != "n" ];then
int '  TCP KeepAlive Interval(Unit:8Sec)' CONFIG_RA_HW_NAT_TCP_KA  1
int '  UDP KeepAlive Interval(Unit:8Sec)' CONFIG_RA_HW_NAT_UDP_KA  1
elif [ "$CONFIG_RA_HW_NAT_TBL_16K" != "n" ];then
int '  TCP KeepAlive Interval(Unit:16Sec)' CONFIG_RA_HW_NAT_TCP_KA  1
int '  UDP KeepAlive Interval(Unit:16Sec)' CONFIG_RA_HW_NAT_UDP_KA  1
fi

comment 'Aging out Time'
int '  Min threshold for unbind state(Pkt count)' CONFIG_RA_HW_NAT_UNB_MNP  1000
int '  Life time of ACL link to FOE entry(Unit:1Sec)' CONFIG_RA_HW_NAT_ACL_DLTA  3
int '  Life time of Unbind entry (Unit:1Sec)'   CONFIG_RA_HW_NAT_UNB_DLTA  3
int '  Life time of Bind UDP entry (Unit:1Sec)' CONFIG_RA_HW_NAT_UDP_DLTA  5
int '  Life time of Bind TCP entry (Unit:1Sec)' CONFIG_RA_HW_NAT_TCP_DLTA  5
int '  Life time of Bind FIN entry (Unit:1Sec)' CONFIG_RA_HW_NAT_FIN_DLTA  5

comment 'Interface Name'
string 'WLAN' CONFIG_RA_HW_NAT_WLAN_NAME "ra0"
string 'PCI' CONFIG_RA_HW_NAT_PCI_NAME "eth0"
string 'GMAC' CONFIG_RA_HW_NAT_GMAC_NAME "eth2"

fi
```

## source/linux-2.6.21.x/ralink/Kconfig
```kconfig
menu "Ralink Module"

###########
# Debuging
###########
source "drivers/net/rt_rdm/Kconfig"

#############
# Wire
#############
source "drivers/net/raeth/Kconfig"

#############
# Wireless
#############
menuconfig WIFI_DRIVER
	bool "WiFi Driver Support"

if WIFI_DRIVER
choice
	prompt "Choose First WiFi Interface"
	config  FIRST_IF_NONE
	bool "None"
	config  FIRST_IF_RT2860
	bool "RT2860"
	depends on RT2860V2_AP
endchoice
choice
	prompt "Choose Second WiFi Interface"
	config  SECOND_IF_NONE
	bool "None"
	config  SECOND_IF_RT3092
	bool "RT3092"
	depends on RT3090_AP || RT3090_AP_INCLUDE
	config  SECOND_IF_RT5392
	bool "RT5392"
	depends on RT5392_AP || RT5392_AP_INCLUDE
	config  SECOND_IF_RT5592
	bool "RT5592"
	depends on RT5592_AP || RT5592_AP_INCLUDE
	config  SECOND_IF_RT3593
	bool "RT3593"
	depends on RT3593_AP || RT3593_AP_INCLUDE
	config  SECOND_IF_RT3572
	bool "RT3572"
	depends on RT3572_AP || RT3572_AP_INCLUDE
	config  SECOND_IF_RT5572
	bool "RT5572"
	depends on RT5572_AP || RT5572_AP_INCLUDE
endchoice

config  RT2860V2_2850
        bool "Dual Band"
        depends on RALINK_RT2880

choice
        prompt "RF Type"
        depends on RALINK_RT5350 
        default RALINK_RT5350_1T1R

        config  RALINK_RT5350_1T1R
        bool "1T1R"
endchoice

choice
        prompt "RF Type"
        depends on RALINK_RT3052
        default RALINK_RT3052_2T2R

        config  RALINK_RT3050_1T1R
        bool "1T1R"

        config  RALINK_RT3051_1T2R
        bool "1T2R"

        config  RALINK_RT3052_2T2R
        bool "2T2R"
endchoice

choice
        prompt "RF Type"
        depends on  RALINK_RT3352 

        config  RALINK_RT3352_2T2R
        bool "2T2R"
endchoice

choice
	prompt "RF Type"
	depends on RALINK_RT3883

	config  RALINK_RT3662_2T2R
	bool "2T3R (RT3662)"

	config  RALINK_RT3883_3T3R
	bool "3T3R (RT3883)"
endchoice

#source "drivers/net/wireless/rt2860v2_ap/Kconfig"
config  RA_CLASSIFIER
	tristate "Ralink Flow Classifier"
	depends on RT2860V2_AP_VIDEO_TURBINE || RT2860V2_STA_VIDEO_TURBINE
	default n

#source "drivers/net/wireless/rt2860v2_sta/Kconfig"

#source "drivers/net/wireless/RT3090_ap/Kconfig"

#source "drivers/net/wireless/RT5392_ap/Kconfig"

#source "drivers/net/wireless/RT5592_ap/Kconfig"

#source "drivers/net/wireless/RT3593_ap/Kconfig"

#source "drivers/net/wireless/RT3572_ap/Kconfig"

#source "drivers/net/wireless/RT5572_ap/Kconfig"

#source "drivers/net/wireless/iNIC/Kconfig"

#source "drivers/net/wireless/iNIC_RT305x/Kconfig"

#source "drivers/net/wireless/RT3680_ap/Kconfig"

config RTDEV_MII
bool
default y if RT2880v2_INIC_MII || RT305x_INIC_MII || RT305x_INIC_USB || RT3680_iNIC_AP

config RTDEV
	bool
	depends on RT3090_AP || RT5392_AP || RT5592_AP || RT3593_AP || RT3572_AP || RT5572_AP || RTDEV_MII
	default y


config  RT_FIRST_CARD
	int
	depends on ! FIRST_IF_NONE
	default 2860

config  RT_SECOND_CARD
	int
	depends on ! SECOND_IF_NONE
	default 3090 if SECOND_IF_RT3092
	default 5392 if SECOND_IF_RT5392
	default 5592 if SECOND_IF_RT5592
	default 3593 if SECOND_IF_RT3593
	default 3572 if SECOND_IF_RT3572
	default 5572 if SECOND_IF_RT5572

config  RT_FIRST_IF_RF_OFFSET
	hex
	depends on ! FIRST_IF_NONE
	default 0x40000

config  RT_SECOND_IF_RF_OFFSET
	hex
	depends on ! SECOND_IF_NONE
	default 0x48000

#config  UNIQUE_WPS
#	bool "Unique WPS for Concurrent AP"
#        depends on RT2860V2_AP_WSC 
#        depends on RT3090_AP_WSC || RT3572_AP_WSC || RT5392_AP_WSC || RT5572_AP_WSC || RT5592_AP_WSC
#	default n
endif # WIFI_DRIVER

#######
# USB
#######
source "drivers/usb/dwc_otg/Kconfig"

#######
# NAT
#######
choice
prompt "Ralink NAT Type"

	
config  RA_NAT_NONE
bool "None"
config  RA_NAT_HW
bool "Hardware"
depends on !RALINK_RT5350
endchoice

source "net/nat/hw_nat/Kconfig"


endmenu
```

## source/linux-2.6.36MT.x/arch/mips/ralink/Kconfig
```kconfig
if RALINK_RT6855A

choice
        prompt "Soc Hardware Type"
	default RT6855A_ASIC

config  RT6855A_FPGA 
	bool "RT6855A/RT6856A-FPGA"

config  RT6855A_ASIC 
	bool "RT6855A/RT6856A-ASIC"

endchoice

endif

config  KERNEL_NVRAM
	bool 'Kernel NVRAM' 
	default n

choice
       prompt "Flash Type"
       default MTD_ANY_RALINK

config MTD_NOR_RALINK
       bool "NOR"
       depends on  !RALINK_RT3352 && !RALINK_RT5350 && !RALINK_RT6855 && !RALINK_RT6855A

config MTD_SPI_RALINK
       bool "SPI"
       depends on  !RALINK_RT2880

config MTD_NAND_RALINK
       bool "NAND"
       depends on  !RALINK_RT3352 && !RALINK_RT2880 && !RALINK_RT5350 && !RALINK_RT6855

config MTD_ANY_RALINK
       bool "ANY (NOR/SPI/NAND)"
       depends on  !RALINK_RT3352 && !RALINK_RT5350

endchoice


choice
	prompt "PCIe Setting"
	default RT6855A_PCIE_PORT0_ENABLE

config  RT6855A_PCIE_PORT0_ENABLE
        bool "Port0 ENABLE Port1 DISABLE(RT6855)"

config  RT6855A_PCIE_PORT01_ENABLE
        bool "Port0&1 ENABLE(RT6856)"
endchoice

choice
	prompt "Root File System Type"
	default RT2880_ROOTFS_IN_RAM

config  RT2880_ROOTFS_IN_RAM
        bool "RootFS_in_RAM"
	select BLK_DEV_INITRD 
	select BLK_DEV_RAM 

#config  RT2880_ROOTFS_IN_FLASH
#        bool "RootFS_in_FLASH"
endchoice

config BLK_DEV_RAM_SIZE
	int 'Default RAM disk size'
	default 8192
	depends on RT2880_ROOTFS_IN_RAM

config ROOTFS_IN_FLASH_NO_PADDING
	bool 'No Padding between Kernel and RootFS'
	default n
	depends on RT2880_ROOTFS_IN_FLASH && !RT2880_FLASH_32M && !DUAL_IMAGE

config MTD_KERNEL_PART_SIZ
	hex 'MTD Kernel Partition Size (Unit:Bytes)'
	default 0xD0000
	depends on RT2880_ROOTFS_IN_FLASH && !ROOTFS_IN_FLASH_NO_PADDING
```

## source/linux-2.6.36MT.x/ralink/Kconfig
```kconfig
menu "Ralink Module"

###########
# Debuging
###########
source "drivers/net/rt_rdm/Kconfig"

#############
# Wire
#############
source "drivers/net/raeth/Kconfig"

#############
# Wireless
#############
menuconfig WIFI_DRIVER
	bool "WiFi Driver Support"

if WIFI_DRIVER
choice
	prompt "Choose First WiFi Interface"
	config  FIRST_IF_NONE
	bool "None"
	config  FIRST_IF_RT3092
	bool "RT3092"
	depends on RT3090_AP || RT3090_AP_INCLUDE
	config  FIRST_IF_RT5392
	bool "RT5392"
	depends on RT5392_AP || RT5392_AP_INCLUDE
	config  FIRST_IF_RT5592
	bool "RT5592"
	depends on RT5592_AP || RT5592_AP_INCLUDE
	config  FIRST_IF_RT3593
	bool "RT3593"
	depends on RT3593_AP || RT3593_AP_INCLUDE
	config  FIRST_IF_RT3572
	bool "RT3572"
	depends on RT3572_AP || RT3572_AP_INCLUDE
	config  FIRST_IF_RT5572
	bool "RT5572"
	depends on RT5572_AP || RT5572_AP_INCLUDE
endchoice
choice
	prompt "Choose Second WiFi Interface"
	config  SECOND_IF_NONE
	bool "None"
	config  SECOND_IF_RT3092
	bool "RT3092"
	depends on RT3090_AP || RT3090_AP_INCLUDE
	config  SECOND_IF_RT5392
	bool "RT5392"
	depends on RT5392_AP || RT5392_AP_INCLUDE
	config  SECOND_IF_RT5592
	bool "RT5592"
	depends on RT5592_AP || RT5592_AP_INCLUDE
	config  SECOND_IF_RT3593
	bool "RT3593"
	depends on RT3593_AP || RT3593_AP_INCLUDE
	config  SECOND_IF_RT3572
	bool "RT3572"
	depends on RT3572_AP || RT3572_AP_INCLUDE
	config  SECOND_IF_RT5572
	bool "RT5572"
	depends on RT5572_AP || RT5572_AP_INCLUDE
endchoice

#source "drivers/net/wireless/RTPCI_ap/Kconfig"

#source "drivers/net/wireless/RT3090_ap/Kconfig"

#source "drivers/net/wireless/RT5392_ap/Kconfig"

#source "drivers/net/wireless/RT5592_ap/Kconfig"

#source "drivers/net/wireless/RT3593_ap/Kconfig"

#source "drivers/net/wireless/RT3572_ap/Kconfig"

#source "drivers/net/wireless/RT5572_ap/Kconfig"

config  RT_FIRST_CARD
	int
	depends on ! FIRST_IF_NONE
	default 3090 if FIRST_IF_RT3092
	default 5392 if FIRST_IF_RT5392
	default 5592 if FIRST_IF_RT5592
	default 3593 if FIRST_IF_RT3593
	default 3572 if FIRST_IF_RT3572
	default 5572 if FIRST_IF_RT5572

config  RT_SECOND_CARD
	int
	depends on ! SECOND_IF_NONE
	default 3090 if SECOND_IF_RT3092
	default 5392 if SECOND_IF_RT5392
	default 5592 if SECOND_IF_RT5592
	default 3593 if SECOND_IF_RT3593
	default 3572 if SECOND_IF_RT3572
	default 5572 if SECOND_IF_RT5572

config  RTDEV
	bool
	depends on ! SECOND_IF_NONE
	default y

config  RT_FIRST_IF_RF_OFFSET
	hex
	depends on ! FIRST_IF_NONE
	default 0x40000

config  RT_SECOND_IF_RF_OFFSET
	hex
	depends on ! SECOND_IF_NONE
	default 0x48000

endif # WIFI_DRIVER

#######
# NAT
#######
choice
prompt "Ralink NAT Type"
	
config  RA_NAT_NONE
bool "None"
config  RA_NAT_HW
bool "Hardware"
endchoice

source "net/nat/hw_nat/Kconfig"

endmenu
```
